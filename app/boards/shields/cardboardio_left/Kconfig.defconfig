## app/boards/shields/cardboardio_left/Kconfig.defconfig
```kconfig
# Copyright (c) 2020 The ZMK Contributors
# SPDX-License-Identifier: MIT

if SHIELD_CARDBOARDIO_LEFT

config ZMK_KEYBOARD_NAME
    default "Cardboardio (left)"

config ZMK_SPLIT
    default n

endif
```

## app/boards/shields/cardboardio_left/Kconfig.shield
```kconfig
# Copyright (c) 2020 The ZMK Contributors
# SPDX-License-Identifier: MIT

config SHIELD_CARDBOARDIO_LEFT
    def_bool $(shields_list_contains,cardboardio_left)
```

## app/boards/shields/cardboardio_right/Kconfig.defconfig
```kconfig
# Copyright (c) 2020 The ZMK Contributors
# SPDX-License-Identifier: MIT

if SHIELD_CARDBOARDIO_RIGHT

config ZMK_KEYBOARD_NAME
    default "Cardboardio (right)"

config ZMK_SPLIT
    default n

endif
```
